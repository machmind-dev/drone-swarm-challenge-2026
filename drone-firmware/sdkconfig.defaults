## drone-vision/ESP32P4/main/Kconfig.projbuild
```kconfig
menu "Drone Vision"

    config VISION_ARUCO_DICT
        int "ArUco dictionary (cv::aruco::PredefinedDictionaryType)"
        default 0
        range 0 20
        help
            0 = DICT_4X4_50  (SDC26 regulation, recommended)
            1 = DICT_4X4_100
            7 = DICT_5X5_50

    config VISION_POSE_MARKER_SIZE_CM
        int "Physical marker side length (cm)"
        default 50
        range 1 200
        help
            SDC26 regulation: 50 cm x 50 cm markers.

endmenu
```
